## conf/bblayers.conf
```bitbake
# Version of layers configuration, specific to
# each defined distro in the repository.
# Format: ${DISTRO}-<version>
TD_BBLAYERS_CONF_VERSION = "tegrademo-3"

BBPATH = "${TOPDIR}"
BBFILES ?= ""

BBLAYERS ?= " \
  /media/kisna/nano_yocto/jetson_yocto_mender/tegra-demo-distro/layers/meta \
  /media/kisna/nano_yocto/jetson_yocto_mender/tegra-demo-distro/layers/meta-tegra \
  /media/kisna/nano_yocto/jetson_yocto_mender/tegra-demo-distro/layers/meta-tegra/contrib \
  /media/kisna/nano_yocto/jetson_yocto_mender/tegra-demo-distro/layers/meta-oe \
  /media/kisna/nano_yocto/jetson_yocto_mender/tegra-demo-distro/layers/meta-python \
  /media/kisna/nano_yocto/jetson_yocto_mender/tegra-demo-distro/layers/meta-networking \
  /media/kisna/nano_yocto/jetson_yocto_mender/tegra-demo-distro/layers/meta-filesystems \
  /media/kisna/nano_yocto/jetson_yocto_mender/tegra-demo-distro/layers/meta-virtualization \
  /media/kisna/nano_yocto/jetson_yocto_mender/tegra-demo-distro/layers/meta-tegra-support \
  /media/kisna/nano_yocto/jetson_yocto_mender/tegra-demo-distro/layers/meta-demo-ci \
  /media/kisna/nano_yocto/jetson_yocto_mender/tegra-demo-distro/layers/meta-tegrademo \
  "
```
